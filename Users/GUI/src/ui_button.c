#ifdef WIN32
//#include "stdafx.h"
#endif
#include "..\..\defs.h"
#include <stdio.h>
#include <stdlib.h>
#include <string.h>
#include "..\inc\ui_button.h"
#include "..\inc\ui_core.h"
#include "..\..\interfaces\inc\if_apis.h"

#if 1
uint8_c g_png_bt1[1244] = {	//24x24px			//NORMAL BUTTON
    0x89, 0x50, 0x4E, 0x47, 0x0D, 0x0A, 0x1A, 0x0A, 0x00, 0x00, 0x00, 0x0D, 0x49, 0x48, 0x44, 0x52,
    0x00, 0x00, 0x00, 0x18, 0x00, 0x00, 0x00, 0x18, 0x08, 0x06, 0x00, 0x00, 0x00, 0xE0, 0x77, 0x3D,
    0xF8, 0x00, 0x00, 0x00, 0x09, 0x70, 0x48, 0x59, 0x73, 0x00, 0x00, 0x0B, 0x13, 0x00, 0x00, 0x0B,
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    0x00, 0x00, 0x00, 0x00, 0x49, 0x45, 0x4E, 0x44, 0xAE, 0x42, 0x60, 0x82 
};

uint8_c g_png_bt2[666] = {	//24x24px		PRESSED BUTTON
    0x89, 0x50, 0x4E, 0x47, 0x0D, 0x0A, 0x1A, 0x0A, 0x00, 0x00, 0x00, 0x0D, 0x49, 0x48, 0x44, 0x52,
    0x00, 0x00, 0x00, 0x18, 0x00, 0x00, 0x00, 0x18, 0x08, 0x06, 0x00, 0x00, 0x00, 0xE0, 0x77, 0x3D,
    0xF8, 0x00, 0x00, 0x00, 0x09, 0x70, 0x48, 0x59, 0x73, 0x00, 0x00, 0x0B, 0x13, 0x00, 0x00, 0x0B,
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    0x00, 0x00, 0x49, 0x45, 0x4E, 0x44, 0xAE, 0x42, 0x60, 0x82 
};

uint8_c g_png_bt3[769] = {			//24x24px		PRESSED BUTTON
    0x89, 0x50, 0x4E, 0x47, 0x0D, 0x0A, 0x1A, 0x0A, 0x00, 0x00, 0x00, 0x0D, 0x49, 0x48, 0x44, 0x52,
    0x00, 0x00, 0x00, 0x18, 0x00, 0x00, 0x00, 0x18, 0x08, 0x06, 0x00, 0x00, 0x00, 0xE0, 0x77, 0x3D,
    0xF8, 0x00, 0x00, 0x00, 0x09, 0x70, 0x48, 0x59, 0x73, 0x00, 0x00, 0x0B, 0x13, 0x00, 0x00, 0x0B,
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    0x76, 0xF4, 0xBB, 0x3E, 0x27, 0x00, 0x00, 0x00, 0x00, 0x49, 0x45, 0x4E, 0x44, 0xAE, 0x42, 0x60,
    0x82 
};

//------------------------------------------------------------
//-----------       Created with 010 Editor        -----------
//------         www.sweetscape.com/010editor/          ------
//
// File    : E:\Research\STM32\KronosCube\Icon\bt4-01.png
// Address : 0 (0x0)
// Size    : 1232 (0x4D0)
//------------------------------------------------------------
uint8_c g_png_bt4[1232] = {			//SUBMIT BUTTON
    0x89, 0x50, 0x4E, 0x47, 0x0D, 0x0A, 0x1A, 0x0A, 0x00, 0x00, 0x00, 0x0D, 0x49, 0x48, 0x44, 0x52,
    0x00, 0x00, 0x00, 0x18, 0x00, 0x00, 0x00, 0x18, 0x08, 0x06, 0x00, 0x00, 0x00, 0xE0, 0x77, 0x3D,
    0xF8, 0x00, 0x00, 0x00, 0x07, 0x74, 0x49, 0x4D, 0x45, 0x07, 0xE2, 0x01, 0x0C, 0x0A, 0x02, 0x1B,
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    0x2F, 0xA1, 0x91, 0x3D, 0x00, 0x00, 0x00, 0x00, 0x49, 0x45, 0x4E, 0x44, 0xAE, 0x42, 0x60, 0x82 
};

#else
//------------------------------------------------------------
//-----------       Created with 010 Editor        -----------
//------         www.sweetscape.com/010editor/          ------
//
// File    : E:\Research\STM32\KronosArt\Icon\bt-01.png
// Address : 0 (0x0)
// Size    : 235 (0xEB)
//------------------------------------------------------------
uint8_c g_png_bt1[257] = {			//24x24 NORMAL BUTTON 
    0x89, 0x50, 0x4E, 0x47, 0x0D, 0x0A, 0x1A, 0x0A, 0x00, 0x00, 0x00, 0x0D, 0x49, 0x48, 0x44, 0x52,
    0x00, 0x00, 0x00, 0x18, 0x00, 0x00, 0x00, 0x18, 0x08, 0x06, 0x00, 0x00, 0x00, 0xE0, 0x77, 0x3D,
    0xF8, 0x00, 0x00, 0x00, 0x09, 0x70, 0x48, 0x59, 0x73, 0x00, 0x00, 0x0B, 0x13, 0x00, 0x00, 0x0B,
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    0x21, 0x5B, 0x12, 0x91, 0x23, 0x00, 0x00, 0x00, 0x00, 0x49, 0x45, 0x4E, 0x44, 0xAE, 0x42, 0x60,
    0x82 
};


//------------------------------------------------------------
//-----------       Created with 010 Editor        -----------
//------         www.sweetscape.com/010editor/          ------
//
// File    : E:\Research\STM32\KronosArt\Icon\bt-02.png
// Address : 0 (0x0)
// Size    : 239 (0xEF)
//------------------------------------------------------------
uint8_c g_png_bt2[255] = {			//24x24 PRESSED BUTTON
	0x89, 0x50, 0x4E, 0x47, 0x0D, 0x0A, 0x1A, 0x0A, 0x00, 0x00, 0x00, 0x0D, 0x49, 0x48, 0x44, 0x52,
    0x00, 0x00, 0x00, 0x18, 0x00, 0x00, 0x00, 0x18, 0x08, 0x06, 0x00, 0x00, 0x00, 0xE0, 0x77, 0x3D,
    0xF8, 0x00, 0x00, 0x00, 0x09, 0x70, 0x48, 0x59, 0x73, 0x00, 0x00, 0x0B, 0x13, 0x00, 0x00, 0x0B,
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    0x90, 0xDD, 0x41, 0x00, 0x00, 0x00, 0x00, 0x49, 0x45, 0x4E, 0x44, 0xAE, 0x42, 0x60, 0x82 
};


//------------------------------------------------------------
//-----------       Created with 010 Editor        -----------
//------         www.sweetscape.com/010editor/          ------
//
// File    : E:\Research\STM32\KronosArt\Icon\bt-03.png
// Address : 0 (0x0)
// Size    : 231 (0xE7)
//------------------------------------------------------------
uint8_c g_png_bt4[247] = {				//24x24 SUBMIT BUTTON
    0x89, 0x50, 0x4E, 0x47, 0x0D, 0x0A, 0x1A, 0x0A, 0x00, 0x00, 0x00, 0x0D, 0x49, 0x48, 0x44, 0x52,
    0x00, 0x00, 0x00, 0x18, 0x00, 0x00, 0x00, 0x18, 0x08, 0x06, 0x00, 0x00, 0x00, 0xE0, 0x77, 0x3D,
    0xF8, 0x00, 0x00, 0x00, 0x09, 0x70, 0x48, 0x59, 0x73, 0x00, 0x00, 0x0B, 0x13, 0x00, 0x00, 0x0B,
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    0x45, 0x4E, 0x44, 0xAE, 0x42, 0x60, 0x82 
};


#endif


void ui_draw_button(gui_handle_p display, ui_rect * rect, uint8 mode) {
	uint16 x = ((ui_rect *)rect)->x;
	uint16 y = ((ui_rect *)rect)->y;
	uint16 w = ((ui_rect *)rect)->w;
	uint16 h = ((ui_rect *)rect)->h;
	ui_object temp1;//, temp2;
	memcpy(&temp1, rect, sizeof(ui_object));
	((ui_rect *)&temp1)->x += 2;
	((ui_rect *)&temp1)->y += 2;
	((ui_rect *)&temp1)->w -= 4;
	((ui_rect *)&temp1)->h -= 4;
	//memcpy(&temp2, &temp1, sizeof(ui_object));
	//((ui_rect *)&temp2)->x += ((ui_rect *)&temp2)->w - 13;
	//((ui_rect *)&temp2)->w = 13;
	//display->draw_rectangle(display, x + 2, y + 2, w - 4, h - 4, UI_COLOR_DARK_GREY, 2);
	//display->draw_rectangle(display, x + 3, y + 3, w - 6, h - 6, UI_COLOR_DARK_GREY, 0);
	if((mode & 0x0F) == UI_BUTTON_STATE_PRESSED) {
		//display->fill_area(display, UI_COLOR_RGB(5,56,127), display->set_area(display, x + 4, y + 3, w - 8, 1));
		//display->fill_area(display, UI_COLOR_RGB(5,56,163), display->set_area(display, x + 3, y + 4, w - 5, h - 6));
		//display->fill_area(display, UI_COLOR_WHITE, display->set_area(display, x + 4, (y + h) - 4, w - 8, 1));
		ui_image_render(display, (ui_rect *)&temp1, (uint8 *)g_png_bt2, sizeof(g_png_bt2), UI_IMAGE_ALIGN_FILL);
		//ui_image_render(display, (ui_rect *)&temp2, (uint8 *)g_png_bt2, sizeof(g_png_bt2), UI_IMAGE_ALIGN_FILL);
	} else {
		//display->fill_area(display, UI_COLOR_WHITE, display->set_area(display, x + 4, y + 3, w - 8, 1));
		//display->fill_area(display, UI_COLOR_RGB(5,56,163), display->set_area(display, x + 3, y + 4, w - 5, h - 6));
		//display->fill_area(display, UI_COLOR_RGB(5,56,127), display->set_area(display, x + 4, (y + h) - 4, w - 8, 1));
		switch(mode & 0xF0) {
			case UI_BUTTON_STYLE_BLUE:
				ui_image_render(display, (ui_rect *)&temp1, (uint8 *)g_png_bt4, sizeof(g_png_bt4), UI_IMAGE_ALIGN_FILL);
				break;
			default: 
				ui_image_render(display, (ui_rect *)&temp1, (uint8 *)g_png_bt1, sizeof(g_png_bt1), UI_IMAGE_ALIGN_FILL);
				break;
		}
	}
}

static void ui_button_render(ui_object * obj, gui_handle_p display) {
	uint16 nc, wtxt, xx, yy;
	uint8 state = UI_BUTTON_STATE_NONE;
	uint16 x = ((ui_rect *)obj)->x;
	uint16 y = ((ui_rect *)obj)->y;
	uint16 w = ((ui_rect *)obj)->w;
	uint16 h = ((ui_rect *)obj)->h;
	obj->backcolor = obj->parent->backcolor;
	if(obj->state & (UI_STATE_INIT | UI_STATE_KEYDOWN | UI_STATE_KEYUP)) {
		//display->fill_area(display, ((ui_object *)obj)->backcolor, display->set_area(display, x, y, w, h));
		nc = strlen((const char *)((ui_text *)obj)->text);
		wtxt = nc * 8;
		xx = ((w - wtxt) >> 1);		//x = width - text_width / 2;
		yy = ((h - UI_FONT_DEFAULT) >> 1);		//y = height - text_height /2;
		display->set_area(display, x, y, w, h);
		//display->draw_rectangle(display, x + 2, y + 2, w - 4, h - 4, UI_COLOR_DARK_GREY, 2);
		//display->draw_rectangle(display, x + 3, y + 3, w - 6, h - 6, UI_COLOR_DARK_GREY, 0);
		if(obj->state & UI_STATE_KEYDOWN) {
			state = UI_BUTTON_STATE_PRESSED;
		}
		
		ui_draw_button(display, (ui_rect *)obj, (((ui_button *)obj)->style & 0xF0) | state);
		display->set_area(display, x, y, w, h);
		display->print_string(display, UI_FONT_DEFAULT, x + xx, y + yy, (uint8 *)((ui_text *)obj)->text, ((ui_object *)obj)->forecolor);
	}
}
uint8_c * g_left_button_text[] = { (uint8_c *)"Cancel", (uint8_c *)"Cancel", (uint8_c *)"No", (uint8_c *)"Abort" };
uint8_c * g_right_button_text[] = { (uint8_c *)"Submit", (uint8_c *)"Ok", (uint8_c *)"Yes", (uint8_c *)"Continue" };
static void ui_buttonset_render(ui_object * obj, gui_handle_p display) {
	uint16 nc, wtxt, xx, yy;
	uint8 state = UI_BUTTON_STATE_NONE;
	uint16 x = ((ui_rect *)obj)->x;
	uint16 y = ((ui_rect *)obj)->y;
	uint16 w = ((ui_rect *)obj)->w;
	uint16 h = ((ui_rect *)obj)->h;
	uint16 wb = w /2;
	ui_object temp;
	uint8 * text;
	uint16 offset_x = 0;
	uint16 cx, cy;
	uint8 style;
	if_touch_get(display, &cx, &cy);
	obj->backcolor = obj->parent->backcolor;
	memcpy(&temp, obj, sizeof(ui_object));
	if(obj->state & (UI_STATE_INIT | UI_STATE_KEYDOWN | UI_STATE_KEYUP)) {
		//display->fill_area(display, ((ui_object *)obj)->backcolor, display->set_area(display, x, y, w, h));
		if(obj->state & UI_STATE_KEYDOWN) {
			state = UI_BUTTON_STATE_PRESSED;
		}
		if(obj->state & UI_STATE_INIT) {
			text = (uint8 *)g_left_button_text[ (((ui_buttonset *)obj)->type >> 4) & 0x03];
			nc = strlen((const char *)text);
			wtxt = nc * 8;
			xx = ((wb - wtxt) >> 1);		//x = width - text_width / 2;
			yy = ((h - UI_FONT_DEFAULT) >> 1);		//y = height - text_height /2;
			((ui_rect *)&temp)->x = x;
			((ui_rect *)&temp)->w = wb;
			display->set_area(display, ((ui_rect *)&temp)->x, ((ui_rect *)&temp)->y, ((ui_rect *)&temp)->w, ((ui_rect *)&temp)->h);
			ui_draw_button(display, (ui_rect *)&temp, (((ui_button *)obj)->style & 0xF0) | state);
			display->print_string(display, UI_FONT_DEFAULT, x + xx, y + yy, text, ((ui_object *)obj)->forecolor);
			
			
			text = (uint8 *)g_right_button_text[ ((ui_buttonset *)obj)->type & 0x03];
			nc = strlen((const char *)text);
			wtxt = nc * 8;
			xx = ((wb - wtxt) >> 1);		//x = width - text_width / 2;
			yy = ((h - UI_FONT_DEFAULT) >> 1);		//y = height - text_height /2;
			xx += wb;
			((ui_rect *)&temp)->x = (x + wb);
			((ui_rect *)&temp)->w = wb;
			display->set_area(display, ((ui_rect *)&temp)->x, ((ui_rect *)&temp)->y, ((ui_rect *)&temp)->w, ((ui_rect *)&temp)->h);
			ui_draw_button(display, (ui_rect *)&temp, (((ui_button *)obj)->style & 0xF0) | state | UI_BUTTON_STYLE_BLUE);
			display->print_string(display, UI_FONT_DEFAULT, x + xx, y + yy, (uint8 *)text, ((ui_object *)obj)->forecolor);
		} else {
			if(cx > (x + (w / 2))) {			//navigation
				text = (uint8 *)g_right_button_text[ ((ui_buttonset *)obj)->type & 0x03];
				offset_x = wb;
				style = (((ui_button *)obj)->style & 0xF0) | state | UI_BUTTON_STYLE_BLUE;
			} else {
				text = (uint8 *)g_left_button_text[ (((ui_buttonset *)obj)->type>> 4) & 0x03];
				style = (((ui_button *)obj)->style & 0xF0) | state;
			}
			nc = strlen((const char *)text);
			wtxt = nc * 8;
			xx = ((wb - wtxt) >> 1);		//x = width - text_width / 2;
			yy = ((h - UI_FONT_DEFAULT) >> 1);		//y = height - text_height /2;
			xx += offset_x;
			((ui_rect *)&temp)->x = (x + offset_x);
			((ui_rect *)&temp)->w = wb;
			display->set_area(display, ((ui_rect *)&temp)->x, ((ui_rect *)&temp)->y, ((ui_rect *)&temp)->w, ((ui_rect *)&temp)->h);
			ui_draw_button(display, (ui_rect *)&temp, style);
			display->print_string(display, UI_FONT_DEFAULT, x + xx, y + yy, (uint8 *)text, ((ui_object *)obj)->forecolor);
		}
	}
}

static void ui_tool_button_render(ui_object * obj, gui_handle_p display) {
	uint16 nc, wtxt, xx, yy;
	uint16 ww, hh, num_pal;
	uint8 i, j, c;
	uint16 offset;
	uint32 color;
	ui_object temp;
	ui_tool_button * tool_btn = (ui_tool_button *)obj;
	
	//uint16 x = display->width - ((ui_object *)obj)->rect.w;
	//uint16 y = 0;
	//uint16 w = ((ui_object *)obj)->rect.w;
	//uint16 h = ((ui_object *)obj)->rect.h;
	if(obj->state != 0) {
		((ui_rect *)obj)->x = obj->rect.x;
		((ui_rect *)obj)->y = obj->rect.y;
		((ui_rect *)obj)->w = obj->rect.w;
		((ui_rect *)obj)->h = obj->rect.h;
		//((ui_object *)obj)->rect.x = x;
		//((ui_object *)obj)->rect.y = y;
		//display->set_area(display, x, y, w, h);
		//if(ui_image_info(((ui_object *)obj)->image, ((ui_object *)obj)->img_size, &ww, &hh) != 0) return;
		//((ui_rect *)obj)->h = hh + 4;
		//calculate and print image
		memcpy(&temp, obj, sizeof(ui_object));
		//xx = ((w - ww) >> 1);
		//display->set_area(display, x + xx, y + 2, ww, hh);
		//((ui_rect *)&temp)->x = x; 
		///((ui_rect *)&temp)->y = y;
		temp.backcolor = (obj->parent)->backcolor;		//use parent back color
		if(obj->state & UI_STATE_KEYDOWN) {
			if(tool_btn->clicked_image.size != 0)
				ui_resource_render(display, (ui_rect *)&temp, &tool_btn->clicked_image, UI_IMAGE_ALIGN_TOP | UI_IMAGE_ALIGN_LEFT);
		} else {
			//release state
			if(((ui_toggle *)obj)->state & UI_TOGGLE_ON) {
				if(tool_btn->clicked_image.size != 0)
					ui_resource_render(display, (ui_rect *)&temp, &tool_btn->clicked_image, UI_IMAGE_ALIGN_TOP | UI_IMAGE_ALIGN_LEFT);
			} else {
				if(tool_btn->normal_image.size != 0)
					ui_resource_render(display, (ui_rect *)&temp, &tool_btn->normal_image, UI_IMAGE_ALIGN_TOP | UI_IMAGE_ALIGN_LEFT);
			}
		}
		
	}
}

static void ui_buttonset_click(ui_object * obj, void * display) {
	uint16 x = ((ui_rect *)obj)->x;
	uint16 y = ((ui_rect *)obj)->y;
	uint16 w = ((ui_rect *)obj)->w;
	uint16 h = ((ui_rect *)obj)->h;
	uint16 cx, cy;
	if_touch_get(display, &cx, &cy);
	
	if(cx > (x + (w / 2))) {			//navigation
		//right button
		((ui_buttonset *)obj)->button_state = UI_BUTTON_STATE_SUBMIT;
		if(((ui_buttonset *)obj)->submit != NULL) ((ui_buttonset *)obj)->submit(obj, display);
	} else {
		//left button
		((ui_buttonset *)obj)->button_state = UI_BUTTON_STATE_CANCEL;
		if(((ui_buttonset *)obj)->cancel != NULL) ((ui_buttonset *)obj)->cancel(obj, display);
	}
}

ui_object * ui_buttonset_create(uint16 type, uint8 id, void (* submit)(ui_object *, void *), void (* cancel)(ui_object *, void *)) {
	ui_buttonset * obj = (ui_buttonset *)ui_create_text(sizeof(ui_buttonset), UI_TYPE_BUTTON | UI_ALIGN_VERTICAL, (char *)"") ;
	((ui_object *)obj)->render = ui_buttonset_render;
	((ui_object *)obj)->rect.h = 48;
	((ui_object *)obj)->forecolor = UI_COLOR_WHITE;
	((ui_object *)obj)->backcolor = UI_COLOR_SLATE_GREY;
	((ui_button *)obj)->style = UI_BUTTON_STYLE_NORMAL;	//UI_BUTTON_STYLE_NORMAL;
	((ui_button *)obj)->id = id;
	((ui_object *)obj)->handler = ui_buttonset_click;
	obj->type = type;
	obj->submit = submit;
	obj->cancel = cancel;
	return (ui_object *)obj;
}

ui_object * ui_button_create(DWORD color, uchar * text, uint8 id, void (* click)(ui_object *, void *)) {
	ui_button * obj = (ui_button *)ui_create_text(sizeof(ui_button), UI_TYPE_BUTTON | UI_ALIGN_VERTICAL, (char *)text) ;
	((ui_object *)obj)->render = ui_button_render;
	((ui_object *)obj)->rect.h = 48;
	((ui_object *)obj)->forecolor = UI_COLOR_WHITE;
	((ui_object *)obj)->backcolor = UI_COLOR_SLATE_GREY;
	obj->style = UI_BUTTON_STYLE_NORMAL;
	obj->id = id;
	((ui_object *)obj)->handler = click;
	return (ui_object *)obj;
}

ui_object * ui_custom_button_create(uint8 * text, ui_rect * rect, uint8 mode, uint8 id, void (* click)(ui_object *, void *)) {
	ui_button * obj = (ui_button *)ui_create_text(sizeof(ui_button), UI_TYPE_BUTTON | UI_ALIGN_FLOAT, (char *)text) ;
	((ui_object *)obj)->render = ui_button_render;
	memcpy(obj, rect, sizeof(ui_rect));
	((ui_object *)obj)->forecolor = UI_COLOR_WHITE;
	((ui_object *)obj)->backcolor = UI_COLOR_SLATE_GREY;
	obj->style = mode;
	obj->id = id;
	((ui_object *)obj)->handler = click;
	return (ui_object *)obj;
}	

ui_object * ui_tool_button_create(ui_rect * rect, ui_resource * normal_image, ui_resource * clicked_image, void (* click)(ui_object *, void *)) {
	ui_tool_button * obj = (ui_tool_button *)ui_create_text(sizeof(ui_tool_button), UI_TYPE_BUTTON | UI_ALIGN_FLOAT, (char *)"") ;
	if(obj != NULL) {
		((ui_object *)obj)->rect.x = rect->x;
		((ui_object *)obj)->rect.y = rect->y;
		((ui_object *)obj)->rect.w = rect->w;
		((ui_object *)obj)->rect.h = rect->h;
		((ui_object *)obj)->forecolor = UI_COLOR_WHITE;
		((ui_object *)obj)->backcolor = UI_COLOR_SLATE_GREY;
		((ui_object *)obj)->render = ui_tool_button_render;
		obj->normal_image.size = 0;
		obj->normal_image.buffer = NULL;
		obj->clicked_image.size = 0;
		obj->clicked_image.buffer = NULL;
		if(normal_image != NULL) memcpy(&obj->normal_image, normal_image, sizeof(ui_resource));
		if(clicked_image != NULL) memcpy(&obj->clicked_image, clicked_image, sizeof(ui_resource));
		((ui_object *)obj)->handler = click;
	}
	return (ui_object *)obj;
}

void ui_button_set_style(ui_object * btn, uint8 style) {
	if(((ui_object *)btn)->type & UI_TYPE_BUTTON) {
		((ui_button *)btn)->style = style;
	}
}