#ifdef WIN32
//#include "stdafx.h"
#endif
//#include <winscard.h>
//#include <memory.h>
#include <stdio.h>
//#include <conio.h>
#include <string.h>
#include <stdlib.h>
#include "defs.h"
#include "config.h"
#include "..\inc\if_apis.h"
#include "wolfssl\wolfcrypt\sha256.h"
static uint32 g_ulSysTickDelay;
const uint8 kronboot[4347];
static uint8 g_index_batt = 0;
static uint8 g_total_batt = 0;
uint16 g_arr_batt[4];

/**
  * @brief System Clock Configuration
  * @retval None
  */
void SystemClock_Config2(void)
{
  RCC_OscInitTypeDef RCC_OscInitStruct = {0};
  RCC_ClkInitTypeDef RCC_ClkInitStruct = {0};

  /** Configure LSE Drive Capability
  */
  HAL_PWR_EnableBkUpAccess();

  /** Configure the main internal regulator output voltage
  */
  __HAL_RCC_PWR_CLK_ENABLE();
  __HAL_PWR_VOLTAGESCALING_CONFIG(PWR_REGULATOR_VOLTAGE_SCALE1);

  /** Initializes the RCC Oscillators according to the specified parameters
  * in the RCC_OscInitTypeDef structure.
  */
  RCC_OscInitStruct.OscillatorType = RCC_OSCILLATORTYPE_HSE;
  RCC_OscInitStruct.HSEState = RCC_HSE_ON;
  RCC_OscInitStruct.PLL.PLLState = RCC_PLL_ON;
  RCC_OscInitStruct.PLL.PLLSource = RCC_PLLSOURCE_HSE;
  RCC_OscInitStruct.PLL.PLLM = 25;
  RCC_OscInitStruct.PLL.PLLN = 384;
  RCC_OscInitStruct.PLL.PLLP = RCC_PLLP_DIV2;
  RCC_OscInitStruct.PLL.PLLQ = 8;
   //RCC_OscInitStruct.PLL.PLLR = 7;
  if (HAL_RCC_OscConfig(&RCC_OscInitStruct) != HAL_OK)
  {
    Error_Handler();
  }

  /** Activate the Over-Drive mode
  */
  if (HAL_PWREx_EnableOverDrive() != HAL_OK)
  {
    Error_Handler();
  }

  /** Initializes the CPU, AHB and APB buses clocks
  */
  RCC_ClkInitStruct.ClockType = RCC_CLOCKTYPE_HCLK|RCC_CLOCKTYPE_SYSCLK
                              |RCC_CLOCKTYPE_PCLK1|RCC_CLOCKTYPE_PCLK2;
  RCC_ClkInitStruct.SYSCLKSource = RCC_SYSCLKSOURCE_PLLCLK;
  RCC_ClkInitStruct.AHBCLKDivider = RCC_SYSCLK_DIV1;
  RCC_ClkInitStruct.APB1CLKDivider = RCC_HCLK_DIV4;
  RCC_ClkInitStruct.APB2CLKDivider = RCC_HCLK_DIV2;

  if (HAL_RCC_ClockConfig(&RCC_ClkInitStruct, FLASH_LATENCY_6) != HAL_OK)
  {
    Error_Handler();
  }
  HAL_RCC_MCOConfig(RCC_MCO1, RCC_MCO1SOURCE_HSE, RCC_MCODIV_1);
}

/**
  * @brief Peripherals Common Clock Configuration
  * @retval None
  */
void PeriphCommonClock_Config2(void)
{
  RCC_PeriphCLKInitTypeDef PeriphClkInitStruct = {0};

  /** Initializes the peripherals clock
  */
  PeriphClkInitStruct.PeriphClockSelection = RCC_PERIPHCLK_LTDC|RCC_PERIPHCLK_SAI1
                              |RCC_PERIPHCLK_SAI2|RCC_PERIPHCLK_CLK48;
  PeriphClkInitStruct.PLLSAI.PLLSAIN = 192;
  PeriphClkInitStruct.PLLSAI.PLLSAIR = 2;
  PeriphClkInitStruct.PLLSAI.PLLSAIQ = 2;
  PeriphClkInitStruct.PLLSAI.PLLSAIP = RCC_PLLSAIP_DIV4;
  PeriphClkInitStruct.PLLSAIDivQ = 1;
  PeriphClkInitStruct.PLLSAIDivR = RCC_PLLSAIDIVR_4;
  PeriphClkInitStruct.Sai1ClockSelection = RCC_SAI1CLKSOURCE_PLLSAI;
  PeriphClkInitStruct.Sai2ClockSelection = RCC_SAI2CLKSOURCE_PLLSAI;
  if (HAL_RCCEx_PeriphCLKConfig(&PeriphClkInitStruct) != HAL_OK)
  {
    Error_Handler();
  }
}

/** System Clock Configuration
*/
void SystemClock_Config(void)
{
	uint16 i;
  RCC_OscInitTypeDef RCC_OscInitStruct;
  RCC_ClkInitTypeDef RCC_ClkInitStruct;
  RCC_PeriphCLKInitTypeDef PeriphClkInitStruct;

  __HAL_RCC_PWR_CLK_ENABLE();
  __HAL_PWR_VOLTAGESCALING_CONFIG(PWR_REGULATOR_VOLTAGE_SCALE1);
	restart_init_osc:
#ifdef STM32F746xx
	SystemClock_Config2();
	PeriphCommonClock_Config2();
	return;
	
  RCC_OscInitStruct.OscillatorType = RCC_OSCILLATORTYPE_HSE;
  RCC_OscInitStruct.HSEState = RCC_HSE_ON;
  RCC_OscInitStruct.PLL.PLLState = RCC_PLL_ON;
  RCC_OscInitStruct.PLL.PLLSource = RCC_PLLSOURCE_HSE;
  RCC_OscInitStruct.PLL.PLLM = 25;
  RCC_OscInitStruct.PLL.PLLN = 400;
  RCC_OscInitStruct.PLL.PLLP = RCC_PLLP_DIV2;
  RCC_OscInitStruct.PLL.PLLQ = 8;
	
	
  //RCC_OscInitStruct.OscillatorType = RCC_OSCILLATORTYPE_HSE;
  //RCC_OscInitStruct.HSEState = RCC_HSE_ON;
  //RCC_OscInitStruct.PLL.PLLState = RCC_PLL_ON;
  //RCC_OscInitStruct.PLL.PLLSource = RCC_PLLSOURCE_HSE;
  //RCC_OscInitStruct.PLL.PLLM = 15;
  //RCC_OscInitStruct.PLL.PLLN = 144;
  //RCC_OscInitStruct.PLL.PLLP = RCC_PLLP_DIV8;
  //RCC_OscInitStruct.PLL.PLLQ = 5;
#endif
#ifdef STM32F765xx
  RCC_OscInitStruct.OscillatorType = RCC_OSCILLATORTYPE_HSE;
  RCC_OscInitStruct.HSEState = RCC_HSE_ON;
  RCC_OscInitStruct.PLL.PLLState = RCC_PLL_ON;
  RCC_OscInitStruct.PLL.PLLSource = RCC_PLLSOURCE_HSE;
  RCC_OscInitStruct.PLL.PLLM = 4;
  RCC_OscInitStruct.PLL.PLLN = 192;
  RCC_OscInitStruct.PLL.PLLP = RCC_PLLP_DIV4;
  RCC_OscInitStruct.PLL.PLLQ = 8;
#endif
#ifdef STM32F407xx
  RCC_OscInitStruct.OscillatorType = RCC_OSCILLATORTYPE_HSE;
  RCC_OscInitStruct.HSEState = RCC_HSE_ON;
  RCC_OscInitStruct.PLL.PLLState = RCC_PLL_ON;
  RCC_OscInitStruct.PLL.PLLSource = RCC_PLLSOURCE_HSE;
  RCC_OscInitStruct.PLL.PLLM = 4;
  RCC_OscInitStruct.PLL.PLLN = 192;
  RCC_OscInitStruct.PLL.PLLP = RCC_PLLP_DIV4;
  RCC_OscInitStruct.PLL.PLLQ = 8;
#endif
#ifdef STM32F417xx
  RCC_OscInitStruct.OscillatorType = RCC_OSCILLATORTYPE_HSE;
  RCC_OscInitStruct.HSEState = RCC_HSE_ON;
  RCC_OscInitStruct.PLL.PLLState = RCC_PLL_ON;
  RCC_OscInitStruct.PLL.PLLSource = RCC_PLLSOURCE_HSE;
  RCC_OscInitStruct.PLL.PLLM = 4;
  RCC_OscInitStruct.PLL.PLLN = 192;
  RCC_OscInitStruct.PLL.PLLP = RCC_PLLP_DIV4;
  RCC_OscInitStruct.PLL.PLLQ = 8;
#endif
#ifdef STM32F413xx
  RCC_OscInitStruct.OscillatorType = RCC_OSCILLATORTYPE_HSI;
  RCC_OscInitStruct.HSEState = RCC_HSI_ON;
  RCC_OscInitStruct.PLL.PLLState = RCC_PLL_ON;
  RCC_OscInitStruct.PLL.PLLSource = RCC_PLLSOURCE_HSI;
  RCC_OscInitStruct.PLL.PLLM = 8;
  RCC_OscInitStruct.PLL.PLLN = 96;			//96 Mhz
  RCC_OscInitStruct.PLL.PLLP = RCC_PLLP_DIV4;
  RCC_OscInitStruct.PLL.PLLQ = 2;
  RCC_OscInitStruct.PLL.PLLP = RCC_PLLP_DIV4;
#endif
	//for(i=0;i<0x8000;i++);
  if (HAL_RCC_OscConfig(&RCC_OscInitStruct) != HAL_OK)
  {
    //Error_Handler();
	  while(1);
  }
  restart_init_pll:
#ifdef STM32F746xx
  RCC_ClkInitStruct.ClockType = RCC_CLOCKTYPE_HCLK|RCC_CLOCKTYPE_SYSCLK
                              |RCC_CLOCKTYPE_PCLK1|RCC_CLOCKTYPE_PCLK2;
  RCC_ClkInitStruct.SYSCLKSource = RCC_SYSCLKSOURCE_PLLCLK;
  RCC_ClkInitStruct.AHBCLKDivider = RCC_SYSCLK_DIV1;
  RCC_ClkInitStruct.APB1CLKDivider = RCC_HCLK_DIV4;
  RCC_ClkInitStruct.APB2CLKDivider = RCC_HCLK_DIV2;
#endif
#ifdef STM32F765xx
  RCC_ClkInitStruct.ClockType = RCC_CLOCKTYPE_HCLK|RCC_CLOCKTYPE_SYSCLK
                              |RCC_CLOCKTYPE_PCLK1|RCC_CLOCKTYPE_PCLK2;
  RCC_ClkInitStruct.SYSCLKSource = RCC_SYSCLKSOURCE_PLLCLK;
  RCC_ClkInitStruct.AHBCLKDivider = RCC_SYSCLK_DIV1;
  RCC_ClkInitStruct.APB1CLKDivider = RCC_HCLK_DIV16;
  RCC_ClkInitStruct.APB2CLKDivider = RCC_HCLK_DIV8;
#endif
#ifdef STM32F417xx
  RCC_ClkInitStruct.ClockType = RCC_CLOCKTYPE_HCLK|RCC_CLOCKTYPE_SYSCLK
                              |RCC_CLOCKTYPE_PCLK1|RCC_CLOCKTYPE_PCLK2;
  RCC_ClkInitStruct.SYSCLKSource = RCC_SYSCLKSOURCE_PLLCLK;
  RCC_ClkInitStruct.AHBCLKDivider = RCC_SYSCLK_DIV1;
  RCC_ClkInitStruct.APB1CLKDivider = RCC_HCLK_DIV16;
  RCC_ClkInitStruct.APB2CLKDivider = RCC_HCLK_DIV8;
#endif
#ifdef STM32F413xx
  RCC_ClkInitStruct.ClockType = RCC_CLOCKTYPE_HCLK|RCC_CLOCKTYPE_SYSCLK
                              |RCC_CLOCKTYPE_PCLK1|RCC_CLOCKTYPE_PCLK2;
  RCC_ClkInitStruct.SYSCLKSource = RCC_SYSCLKSOURCE_PLLCLK;
  RCC_ClkInitStruct.AHBCLKDivider = RCC_SYSCLK_DIV1;	//96Mhz
  RCC_ClkInitStruct.APB1CLKDivider = RCC_HCLK_DIV2;		//48Mhz
  RCC_ClkInitStruct.APB2CLKDivider = RCC_HCLK_DIV1;		//96Mhz
#endif
	//for(i=0;i<0x8000;i++);
  if (HAL_RCC_ClockConfig(&RCC_ClkInitStruct, FLASH_LATENCY_6) != HAL_OK)
  {
    //Error_Handler();
	  while(1);
  }

  HAL_SYSTICK_Config(HAL_RCC_GetHCLKFreq()/1000);

  HAL_SYSTICK_CLKSourceConfig(SYSTICK_CLKSOURCE_HCLK);
  
  /* SysTick_IRQn interrupt configuration */
  HAL_NVIC_SetPriority(SysTick_IRQn, 2, 1);
}

void PeriphCommonClock_Config(void)
{
  RCC_PeriphCLKInitTypeDef PeriphClkInitStruct = {0};

  /** Initializes the peripherals clock
  */
  PeriphClkInitStruct.PeriphClockSelection = RCC_PERIPHCLK_LTDC|RCC_PERIPHCLK_SAI1
                              |RCC_PERIPHCLK_SAI2|RCC_PERIPHCLK_CLK48;
  PeriphClkInitStruct.PLLSAI.PLLSAIN = 60;
  PeriphClkInitStruct.PLLSAI.PLLSAIR = 2;
  PeriphClkInitStruct.PLLSAI.PLLSAIQ = 2;
  PeriphClkInitStruct.PLLSAI.PLLSAIP = RCC_PLLSAIP_DIV2;
  PeriphClkInitStruct.PLLSAIDivQ = 1;
  PeriphClkInitStruct.PLLSAIDivR = RCC_PLLSAIDIVR_2;
  PeriphClkInitStruct.Sai1ClockSelection = RCC_SAI1CLKSOURCE_PLLSAI;
  PeriphClkInitStruct.Sai2ClockSelection = RCC_SAI2CLKSOURCE_PLLSAI;
  if (HAL_RCCEx_PeriphCLKConfig(&PeriphClkInitStruct) != HAL_OK)
  {
    Error_Handler();
  }
}

ADC_HandleTypeDef hadc1;
static void if_pwr_init() {
	GPIO_InitTypeDef GPIO_InitStruct;       
	ADC_ChannelConfTypeDef sConfig;

	__HAL_RCC_ADC1_CLK_ENABLE();
	__HAL_RCC_GPIOD_CLK_ENABLE();
	__HAL_RCC_GPIOB_CLK_ENABLE();
	__HAL_RCC_GPIOE_CLK_ENABLE();
    /**Configure the global features of the ADC (Clock, Resolution, Data Alignment and number of conversion) 
    */
	hadc1.Instance = ADC1;
	hadc1.Init.ClockPrescaler = ADC_CLOCK_SYNC_PCLK_DIV2;
	hadc1.Init.Resolution = ADC_RESOLUTION_12B;
	hadc1.Init.ScanConvMode = DISABLE;
	hadc1.Init.ContinuousConvMode = ENABLE;
	hadc1.Init.DiscontinuousConvMode = DISABLE;
	hadc1.Init.ExternalTrigConvEdge = ADC_EXTERNALTRIGCONVEDGE_NONE;
	hadc1.Init.DataAlign = ADC_DATAALIGN_RIGHT;
	hadc1.Init.NbrOfConversion = 1;
	hadc1.Init.DMAContinuousRequests = DISABLE;
	hadc1.Init.EOCSelection = ADC_EOC_SINGLE_CONV;
	if (HAL_ADC_Init(&hadc1) != HAL_OK)
	{
		return;
	}

    /**Configure for the selected ADC regular channel its corresponding rank in the sequencer and its sample time. 
    */
	sConfig.Channel = ADC_CHANNEL_VBAT;//ADC_CHANNEL_8;
	sConfig.Rank = 1;
	sConfig.SamplingTime = ADC_SAMPLETIME_3CYCLES;
	if (HAL_ADC_ConfigChannel(&hadc1, &sConfig) != HAL_OK)
	{
		return;
	}
	
	__HAL_ADC_ENABLE(&hadc1);
  
  
    /**ADC1 GPIO Configuration    
    PB0     ------> ADC1_IN8 
    */
    GPIO_InitStruct.Pin = GPIO_PIN_0;
    GPIO_InitStruct.Mode = GPIO_MODE_ANALOG;
    GPIO_InitStruct.Pull = GPIO_NOPULL;
	GPIO_InitStruct.Speed = GPIO_SPEED_FREQ_HIGH;
    HAL_GPIO_Init(GPIOB, &GPIO_InitStruct);
	
	
    GPIO_InitStruct.Pin = GPIO_PIN_5;
    GPIO_InitStruct.Mode = GPIO_MODE_INPUT;
    GPIO_InitStruct.Pull = GPIO_PULLUP;
	GPIO_InitStruct.Speed = GPIO_SPEED_FREQ_LOW;
    HAL_GPIO_Init(GPIOB, &GPIO_InitStruct);
	
#if !defined(STM32F746xx)		//not discovery board
	//BTIN, charging indicator
    GPIO_InitStruct.Pin = GPIO_PIN_8;
    GPIO_InitStruct.Mode = GPIO_MODE_INPUT;
    GPIO_InitStruct.Pull = GPIO_PULLUP;
	GPIO_InitStruct.Speed = GPIO_SPEED_FREQ_LOW;
    HAL_GPIO_Init(GPIOE, &GPIO_InitStruct);
		
	//USB Power Disable
    GPIO_InitStruct.Pin = GPIO_PIN_0;
    GPIO_InitStruct.Mode = GPIO_MODE_OUTPUT_PP;
    GPIO_InitStruct.Pull = GPIO_PULLUP;
	GPIO_InitStruct.Speed = GPIO_SPEED_FREQ_HIGH;
    HAL_GPIO_Init(GPIOD, &GPIO_InitStruct);
	HAL_GPIO_WritePin(GPIOD, GPIO_PIN_0, GPIO_PIN_RESET);
#endif
	
}
//static void if_rtc_tick(void * params) {	
//}
RNG_HandleTypeDef g_RNG_InitStructure;
void if_sys_init(void * sys) {
	RCC_ClkInitTypeDef RCC_ClkInitStruct;
	uint32 core, pclk1, pclk2, ahb;
	//RCC_ClocksTypeDef curConf;
	HAL_Init();
	//RCC_HSEConfig(RCC_HSE_ON);
	//SystemInit();							//clock, PLL and Flash configuration
	//__HAL_RCC_HSE_CONFIG(RCC_HSE_ON);
	//RCC_SYSCLKConfig(RCC_SYSCLKSource_HSE);
	//__HAL_RCC_SYSCLK_CONFIG(RCC_SYSCLKSOURCE_PLLCLK);
	//switch to core clock
	#if 0
	RCC_ClkInitStruct.AHBCLKDivider = RCC_SYSCLK_DIV1;
	RCC_ClkInitStruct.APB1CLKDivider = RCC_HCLK_DIV1;
	RCC_ClkInitStruct.APB2CLKDivider = RCC_HCLK_DIV2;
	
	RCC_ClkInitStruct.ClockType = RCC_CLOCKTYPE_SYSCLK;
	RCC_ClkInitStruct.SYSCLKSource = RCC_SYSCLKSOURCE_PLLCLK;
	HAL_RCC_ClockConfig(&RCC_ClkInitStruct, FLASH_LATENCY_0);
	#endif
	//SystemCoreClockUpdate();
	SystemClock_Config();
	//PeriphCommonClock_Config();
	core = HAL_RCC_GetSysClockFreq();
	ahb = HAL_RCC_GetHCLKFreq();
	pclk1 = HAL_RCC_GetPCLK1Freq();
	pclk2 = HAL_RCC_GetPCLK2Freq();
	SysTick_Config(HAL_RCC_GetHCLKFreq() / 1000);				//Systick (1ms)
	//SysTick_Config(192000);				//Systick (1ms)
	
  	__HAL_RCC_PWR_CLK_ENABLE();
  	HAL_PWR_EnableBkUpAccess();
	//if_time_init();
	
	__HAL_RCC_RNG_CLK_ENABLE();
	//RNG_Cmd(ENABLE);
	g_RNG_InitStructure.Instance = RNG;
	HAL_RNG_Init(&g_RNG_InitStructure);
	if_pwr_init(); 
	//check for battery
#if SHARD_AUTO_POWER_DOWN
	if(if_pwr_get_batt_percent() < 4) {
		while(1) {
			//if_net_sleep(tctx.netctx);
			//((gui_handle_p)tctx.display)->set_backlight(tctx.display, 0);
			//HAL_PWR_EnterSLEEPMode(PWR_LOWPOWERREGULATOR_ON, PWR_SLEEPENTRY_WFI);
			HAL_PWR_EnterSTOPMode(PWR_LOWPOWERREGULATOR_ON, PWR_STOPENTRY_WFI);
		}
	}
#endif
}

void if_sys_sleep() {
	//HAL_SYSTICK_CLKSourceConfig(SYSTICK_CLKSOURCE_HCLK_DIV8);		//slow
	RCC_OscInitTypeDef RCC_OscInitStruct;
	RCC_ClkInitTypeDef RCC_ClkInitStruct;
	OS_DEBUG_ENTRY(if_sys_sleep);
	__HAL_RCC_ADC1_CLK_DISABLE();
	__HAL_RCC_RNG_CLK_DISABLE();
	__HAL_RCC_GPIOE_CLK_DISABLE();
	__HAL_RCC_GPIOD_CLK_DISABLE();
	//switch to HSI
	RCC_ClkInitStruct.ClockType = RCC_CLOCKTYPE_HCLK|RCC_CLOCKTYPE_SYSCLK
								  |RCC_CLOCKTYPE_PCLK1|RCC_CLOCKTYPE_PCLK2;
	RCC_ClkInitStruct.SYSCLKSource = RCC_SYSCLKSOURCE_HSI;
	RCC_ClkInitStruct.AHBCLKDivider = RCC_SYSCLK_DIV1;
	RCC_ClkInitStruct.APB1CLKDivider = RCC_HCLK_DIV16;
	RCC_ClkInitStruct.APB2CLKDivider = RCC_HCLK_DIV8;
		//for(i=0;i<0x8000;i++);
	if (HAL_RCC_ClockConfig(&RCC_ClkInitStruct, FLASH_LATENCY_3) != HAL_OK)
	{
		//Error_Handler();
		//while(1);
	}
	//disable PLL and HSE
	RCC_OscInitStruct.OscillatorType = RCC_OSCILLATORTYPE_HSE;
	RCC_OscInitStruct.HSEState = RCC_HSE_OFF;
	RCC_OscInitStruct.PLL.PLLState = RCC_PLL_OFF;
	RCC_OscInitStruct.PLL.PLLSource = RCC_PLLSOURCE_HSE;
	RCC_OscInitStruct.PLL.PLLM = 4;
	RCC_OscInitStruct.PLL.PLLN = 192;
	RCC_OscInitStruct.PLL.PLLP = RCC_PLLP_DIV4;
	RCC_OscInitStruct.PLL.PLLQ = 8;
	if (HAL_RCC_OscConfig(&RCC_OscInitStruct) != HAL_OK)
	{
		//Error_Handler();
		//while(1);
	}
	
	__HAL_RCC_PLL_DISABLE();
	__HAL_RCC_HSE_CONFIG(RCC_HSE_OFF);
	__HAL_PWR_VOLTAGESCALING_CONFIG(PWR_REGULATOR_VOLTAGE_SCALE2);
  	///__HAL_RCC_PWR_CLK_DISABLE();
	OS_DEBUG_EXIT();
}

void if_sys_wake() {
	RCC_OscInitTypeDef RCC_OscInitStruct;
	RCC_ClkInitTypeDef RCC_ClkInitStruct;
	OS_DEBUG_ENTRY(if_sys_wake);
	__HAL_PWR_VOLTAGESCALING_CONFIG(PWR_REGULATOR_VOLTAGE_SCALE1);
	__HAL_RCC_PLL_ENABLE();
	__HAL_RCC_HSE_CONFIG(RCC_HSE_ON);
	//HAL_SYSTICK_CLKSourceConfig(SYSTICK_CLKSOURCE_HCLK);
	RCC_OscInitStruct.OscillatorType = RCC_OSCILLATORTYPE_HSE;
	RCC_OscInitStruct.HSEState = RCC_HSE_ON;
	RCC_OscInitStruct.PLL.PLLState = RCC_PLL_ON;
	RCC_OscInitStruct.PLL.PLLSource = RCC_PLLSOURCE_HSE;
	RCC_OscInitStruct.PLL.PLLM = 4;
	RCC_OscInitStruct.PLL.PLLN = 192;
	RCC_OscInitStruct.PLL.PLLP = RCC_PLLP_DIV4;
	RCC_OscInitStruct.PLL.PLLQ = 8;
		//for(i=0;i<0x8000;i++);
	if (HAL_RCC_OscConfig(&RCC_OscInitStruct) != HAL_OK)
	{
		//Error_Handler();
		while(1);
	}

	RCC_ClkInitStruct.ClockType = RCC_CLOCKTYPE_HCLK|RCC_CLOCKTYPE_SYSCLK
								  |RCC_CLOCKTYPE_PCLK1|RCC_CLOCKTYPE_PCLK2;
	RCC_ClkInitStruct.SYSCLKSource = RCC_SYSCLKSOURCE_PLLCLK;
	RCC_ClkInitStruct.AHBCLKDivider = RCC_SYSCLK_DIV1;
	RCC_ClkInitStruct.APB1CLKDivider = RCC_HCLK_DIV16;
	RCC_ClkInitStruct.APB2CLKDivider = RCC_HCLK_DIV8;
		//for(i=0;i<0x8000;i++);
	if (HAL_RCC_ClockConfig(&RCC_ClkInitStruct, FLASH_LATENCY_3) != HAL_OK)
	{
		//Error_Handler();
		while(1);
	}
	__HAL_RCC_RNG_CLK_ENABLE();
	__HAL_RCC_ADC1_CLK_ENABLE();
	__HAL_RCC_GPIOE_CLK_ENABLE();
	__HAL_RCC_GPIOD_CLK_ENABLE();
	//reset batt percent
	g_index_batt = 0;
	g_total_batt = 0;
	if_pwr_get_batt_percent();
	OS_DEBUG_EXIT();
}

uint32 if_sys_tick() {
	return HAL_GetTick();
}

#if 0
uint16_t gwa_bkplog2phys[] = {  
	RTC_BKP_DR1, 		RTC_BKP_DR2, 		RTC_BKP_DR3, 		RTC_BKP_DR4,
	RTC_BKP_DR5, 		RTC_BKP_DR6, 		RTC_BKP_DR7, 		RTC_BKP_DR8,
	RTC_BKP_DR9, 		RTC_BKP_DR10, 		RTC_BKP_DR11, 		RTC_BKP_DR12,
	RTC_BKP_DR13, 		RTC_BKP_DR14, 		RTC_BKP_DR15, 		RTC_BKP_DR16,
	RTC_BKP_DR17,		RTC_BKP_DR18,		RTC_BKP_DR19
};
#endif

void if_config_write(void * data, uint16 size) {
	if_flash_data_write(NULL, 0, data, size);
}

uint8 if_config_read(void * data, uint16 size) {
	return if_flash_data_read(NULL, 0, data, size);
}

uint8 if_pwr_get_batt_percent() {
	uint32 conval;
	uint16 sigma = 0;
	uint8 i;
	if(HAL_ADC_Start(&hadc1) == HAL_OK) {
		HAL_ADC_PollForConversion(&hadc1, 3200);
		conval = HAL_ADC_GetValue(&hadc1);
		HAL_ADC_Stop(&hadc1);
	}
	g_arr_batt[g_index_batt++] = conval;
	if(g_index_batt == 4) g_index_batt = 0;
	if(g_total_batt < 4) { g_total_batt++; }
	for(i=0;i<g_total_batt;i++) sigma += g_arr_batt[i];
	conval = sigma/g_total_batt;
#ifdef STM32F7
	//VBAT = ((ADC18_value * 4) / 0x10000) * VREF
	if(conval < 0x39c) return 0;
	if(conval > 0x530) return 100;
	return ((conval - 0x39c) * 100) / 0x194;

#endif
#ifdef STM32F4	
#ifdef STM32F427xx
	if(conval < 0x300) return 0;
	if(conval > 0x500) return 100;
	return ((conval - 0x300) * 100) / 0x200;	
#else
	if(conval < 0x700) return 0;
	if(conval > 0x900) return 100;
	return ((conval - 0x700) * 100) / 0x200;
#endif
#endif
}

uint8 if_pwr_is_charging() {
#ifdef STM32F7
	return HAL_GPIO_ReadPin(GPIOB, GPIO_PIN_5) == GPIO_PIN_SET;
#endif
#ifdef STM32F4	
#ifdef STM32F427xx
	return 0;				//need to define pin
#else
	return HAL_GPIO_ReadPin(GPIOB, GPIO_PIN_5) == GPIO_PIN_SET;
#endif
#endif
}

static RTC_HandleTypeDef g_hrtc;
void if_time_init() {
	__HAL_RCC_RTC_CONFIG(RCC_RTCCLKSOURCE_LSE);
	__HAL_RCC_LSE_CONFIG(RCC_LSE_ON);
	__HAL_RCC_RTC_ENABLE();
	//__HAL_RCC_RTC_CONFIG(RCC_RTCCLKSOURCE_LSE);
	//__HAL_RCC_RTC_ENABLE();
	/* Enable LSE */
	//if(!if_time_is_running()) {
	//}
}

uint8 if_time_is_running() {
	//return *(__IO uint32_t *) RCC_BDCR_RTCEN_BB == ENABLE;
	return (RCC->BDCR & RCC_BDCR_RTCEN);
}

void if_time_set(datetime_p value) {
	uint32 temp;
	RTC_TimeTypeDef stime, wtime;
	RTC_DateTypeDef sdate, wdate;
	uint32 cpu_sr;
	uint8 hour = value->hour % 12;
	uint16 year = value->year - 1970;
	uint8 bcd_second = ((value->second / 10) << 4) | (value->second % 10);
	uint8 bcd_minute = ((value->minute / 10) << 4) | (value->minute % 10);
	uint8 bcd_hour = ((hour / 10) << 4) | (hour % 10);
	uint8 bcd_date =  ((value->date / 10) << 4) | (value->date % 10);
	uint8 bcd_month = ((value->month / 10) << 4) | (value->month % 10);
	uint8 bcd_year =  ((year / 10) << 4) | (year % 10);
	//enable RTC first
	__HAL_RCC_LSE_CONFIG(RCC_LSE_ON);
	__HAL_RCC_RTC_CONFIG(RCC_RTCCLKSOURCE_LSE);
	__HAL_RCC_RTC_ENABLE();
	//cpu_sr = os_enter_critical();
	stime.DayLightSaving = RTC_DAYLIGHTSAVING_NONE;
	stime.StoreOperation = RTC_STOREOPERATION_SET;
	stime.SecondFraction = 0;
	stime.SubSeconds = 0;
	stime.Hours = bcd_hour;	//value->hour;
	if(value->hour >= 12) stime.TimeFormat = RTC_HOURFORMAT12_PM;
	else stime.TimeFormat = RTC_HOURFORMAT12_AM;
	stime.Minutes = bcd_minute;		//value->minute;
	stime.Seconds = bcd_second;	//value->second;
	sdate.Date = bcd_date;		//value->date;
	sdate.Month = bcd_month;		//value->month;
	sdate.Year = bcd_year;	//value->year - 1970;
	sdate.WeekDay = RTC_WEEKDAY_MONDAY;
	//clear RTC variables first
	/*
	memset(&wdate, 0, sizeof(RTC_TimeTypeDef));
	memset(&wtime, 0, sizeof(RTC_TimeTypeDef));
	HAL_RTC_SetDate(&g_hrtc, &wdate, RTC_FORMAT_BCD);			//date
	HAL_RTC_SetTime(&g_hrtc, &wtime, RTC_FORMAT_BCD);			//time
	RTC->BKP0R = 0;
	*/
	
	g_hrtc.Instance = RTC;
	g_hrtc.Init.HourFormat = RTC_HOURFORMAT_12;
	g_hrtc.Init.AsynchPrediv = 0x7F;		//1;			//0x7F;		//STMF4_User_manual p789
	g_hrtc.Init.SynchPrediv = 0xFF;		//16379;		//0xFF;
	g_hrtc.Init.OutPut = RTC_OUTPUT_DISABLE;
	HAL_RTC_Init(&g_hrtc);// != HAL_OK);
	
	//write the new value
	//while(g_hrtc.State != HAL_RTC_STATE_READY);
	HAL_RTC_SetDate(&g_hrtc, &sdate, RTC_FORMAT_BCD);			//date
	//while(g_hrtc.State != HAL_RTC_STATE_READY);
	HAL_RTC_SetTime(&g_hrtc, &stime, RTC_FORMAT_BCD);			//time
	//os_exit_critical(cpu_sr);
	RTC->BKP0R = value->tz;												//timezone
	//__HAL_RCC_RTC_CONFIG(RCC_RTCCLKSOURCE_LSE);
}

uint32 if_time_get(datetime_p value) {
	//return RTC_GetCounter();
	uint8 bcd_second = RTC->TR & 0xFF;
	uint8 bcd_minute = (RTC->TR >> 8) & 0xFF;
	uint8 bcd_hour = (RTC->TR >> 16) & 0x3F;
	uint8 bcd_date = RTC->DR & 0xFF;
	uint8 bcd_month = (RTC->DR >> 8) & 0x1F;
	uint8 bcd_year = (RTC->DR >> 16) & 0xFF;
	uint8 bcd_week = RTC->DR >> 9;
	uint8 second = ((bcd_second >> 4) * 10) + (bcd_second & 0x0F);
	uint8 minute = ((bcd_minute >> 4) * 10) + (bcd_minute & 0x0F);
	uint8 hour = ((bcd_hour >> 4) * 10) + (bcd_hour & 0x0F);
	uint8 date = ((bcd_date >> 4) * 10) + (bcd_date & 0x0F);
	uint8 month = ((bcd_month >> 4) * 10) + (bcd_month & 0x0F);
	uint8 year = ((bcd_year >> 4) * 10) + (bcd_year & 0x0F);
	//if(RTC->TR & (1 << 22)) hour += 12;
	if(hour == 12) hour = 0;
	if(RTC->TR & (1 << 22)) hour += 12;
	value->second = second % 60;		//second
	value->minute = minute % 60;		//minute
	value->hour = hour % 24;			//hour
	value->date = date;					//date
	value->month = month;				//month
	value->year = year + 1970;			//year
	value->tz = RTC->BKP0R;			//timezone
	return 0;
}

void if_delay_tick(void)
{
	static uint8 btick =0;
  if (g_ulSysTickDelay != 0x00)
  { 
    g_ulSysTickDelay--;
  }
  btick = !btick;
  if(btick) {
	//GPIO_ResetBits(GPIOA, GPIO_PIN_4);
  } else {
	//GPIO_SetBits(GPIOA, GPIO_PIN_4);	
  }
}

#ifdef USE_HAL_DRIVER
void HAL_SYSTICK_Callback(void) {
	if_delay_tick();
}
#endif

#if (SHARD_RTOS_ENABLED == 0)
void if_delay(uint32 ms) {
  g_ulSysTickDelay = ms;

  while(g_ulSysTickDelay != 0);
}
#endif

static uint8 g_err_len;
static uint8 g_err_buff[256];
static uint32 g_err_code = 0;
uint32 if_get_last_error(uint8 * buffer) {
	memcpy(buffer, g_err_buff, g_err_len);
	buffer[g_err_len] = 0;
	return g_err_code;
}

void if_set_last_error(uint32 code, uint8 * buffer, uint8 size) {
	memcpy(g_err_buff, buffer, size);
	g_err_len = size;
}

void if_clear_error() {
	g_err_code = 0;
	g_err_len = 0;
}

//transmit tcp request and wait for response
uint32 if_download_update(net_context_p ctx, uint8 * url, uint32 * address, uint8 * sign) {
	uint16 plen;
	uint32 len;
	uint8 host[210];
	uint8 cbuf[512];
	uint32 i = 0;
	FLASH_EraseInitTypeDef FLASH_EraseInitStructure;
	uint32 sector_error;
	uint32 base_addr;
	uint32 timeout = (800000 * 1000);
	uint8 * ptr;
	uint8 c;
	uint8 state;
	uint8 hdr[256];
	uint8 ihdr = 0;
	uint16 port = 80;
	uint32 content_length = 0;
	uint32 data_length = 0;
	uint8 line_cntr = 0;
	bfd_info b_info;
	net_conn_p conn;
#if SHARD_RTOS_ENABLED
	uint32 cpu_sr;
#endif
	uint8 b_len;
	len = 0;
	if((ctx->state & IF_NET_STATE_CONNECTED) == 0) return 0;		//not connected
#if SHARD_RTOS_ENABLED
	cpu_sr = os_enter_critical();
#endif
	NET_LOCK_CRITICAL(ctx);
	//start decode URL
	ptr = net_decode_url(url, &port, host);
	sprintf((char *)cbuf, "GET %s HTTP/1.1\r\nHost: %s\r\n\r\n", ptr, host);
	//connecting to Host
	if((conn = ctx->sock_open(ctx, host, port, NET_TRANSMIT)) == NULL)  {
		//error connecting to server
		NET_UNLOCK_CRITICAL(ctx);
#if SHARD_RTOS_ENABLED
		os_exit_critical(cpu_sr);
#endif
		return 0;
	}
	//flash unlock
	HAL_FLASH_Unlock();
#ifdef STM32F407xx
	__HAL_FLASH_CLEAR_FLAG(FLASH_FLAG_EOP | FLASH_FLAG_OPERR | FLASH_FLAG_WRPERR | FLASH_FLAG_PGAERR | FLASH_FLAG_PGPERR | FLASH_FLAG_PGSERR);
#endif
#ifdef STM32F746xx
	__HAL_FLASH_CLEAR_FLAG(FLASH_FLAG_EOP | FLASH_FLAG_OPERR | FLASH_FLAG_WRPERR | FLASH_FLAG_PGAERR | FLASH_FLAG_PGPERR | FLASH_FLAG_ERSERR);
#endif
	//start erasing flash
	FLASH_EraseInitStructure.Sector = 8;
	FLASH_EraseInitStructure.TypeErase = FLASH_TYPEERASE_SECTORS;
	FLASH_EraseInitStructure.VoltageRange = FLASH_VOLTAGE_RANGE_3;
	//FLASH_EraseInitStructure.Banks = FLASH_BANK_1;
	FLASH_EraseInitStructure.NbSectors = 4;
	HAL_FLASHEx_Erase(&FLASH_EraseInitStructure, &sector_error);
	//if(sector_error != 0xFFFFFFFFU) goto close_connection;
	//start transmit HTTP request
	if_net_tcp_send(conn, cbuf, strlen((const char *)cbuf));
	len = 0;
	base_addr = 0x08080000 + sizeof(bfd_info);		//temporary area
	address[0] = base_addr;
	if(if_net_tcp_accept(conn) == 0) {
		while(1) {
			for(i=0;i<timeout;i++) { if(__HAL_USART_GET_FLAG((USART_HandleTypeDef *)ctx, USART_FLAG_RXNE) != RESET) break; }
			if(i == timeout) goto close_connection;
			for(i=0;i<20000;i++) {  
				if(__HAL_USART_GET_FLAG((USART_HandleTypeDef *)ctx, USART_FLAG_RXNE) != SET) continue;
				i = 0;
#if SHARD_WIFI_MODULE == MOD_ESP8266
				switch(state) {
					default:
					case 0:
						hdr[ihdr++] = ctx->handle.Instance->DR;
						hdr[ihdr] = 0;
						if((ptr = (uint8 *)strstr((char *)hdr, "+IPD,")) != NULL) {
							state = 1;
						} 
						else if(strstr((char *)hdr, "SEND FAIL") != NULL) { len = 0; goto close_connection; }
						else if(strstr((char *)hdr, "ERROR") != NULL) { len = 0; goto close_connection;  }				//link not valid
						else if(strstr((char *)hdr, "CLOSED") != NULL) goto close_connection; 
						break;
					case 1:		//reset index header
						ihdr = 0;
						state = 2;		//wait for length
					case 2:
						hdr[ihdr++] = c = ctx->handle.Instance->DR;
						if(c == ',') ihdr = 0;		//found comma, reset header
						if(c == ':') { 
							hdr[ihdr] = 0;
							plen = atoi((const char *)hdr);		//data length fetched
							if(content_length == 0) state = 3;
							else state = 8;
							ihdr = 0;
						}
						break;
					case 3:
						plen--;
						hdr[ihdr++] = c = ctx->handle.Instance->DR;
						if(c == '\n') {
							hdr[ihdr] = 0;
							if((ptr = (uint8 *)strstr((char *)hdr, "Content-Length:")) != NULL) {
								content_length = atoi((const char *)ptr + 15);
								state = 4;
							}
							ihdr = 0;
						}
						break;
					case 4:
						plen--;
						hdr[ihdr++] = c = ctx->handle.Instance->DR;
						if(c == '\n') {
							hdr[ihdr] = 0;
							if((ptr = (uint8 *)strstr((char *)hdr, "Content-Type:")) != NULL) {
								//content_length = atoi((const char *)ptr + 13);
								state = 5;
							}
							ihdr = 0;
						}
						break;
					case 5:
						plen--;
						hdr[ihdr++] = c = ctx->handle.Instance->DR;
						hdr[ihdr] = 0;
						if(c == '\n') {
							if(strlen((const char *)hdr) == 2) state = 8;
							ihdr = 0;
						}
						break;
					case 8:
						c = ctx->handle.Instance->DR;
						HAL_FLASH_Program(FLASH_TYPEPROGRAM_BYTE, (uint32_t)base_addr++, c);
						if(--plen == 0) state = 0;		//start waiting for next frame
						break;
				}
#endif
#if SHARD_WIFI_MODULE == MOD_RTL8710
				switch(state) {
					default:
					case 0:
						hdr[ihdr++] = ctx->handle.Instance->DR;
						hdr[ihdr] = 0;
						c = ctx->handle.Instance->DR;
						if(c == '\n') {
							hdr[ihdr] = 0;
							if((ptr = (uint8 *)strstr((char *)hdr, "Content-Length:")) != NULL) {
								content_length = atoi((const char *)ptr + 15);
								state = 1;
							}
							ihdr = 0;
						}
						break;
					case 1:
						hdr[ihdr++] = c = ctx->handle.Instance->DR;
						if(c == '\n') {
							hdr[ihdr] = 0;
							if((ptr = (uint8 *)strstr((char *)hdr, "Content-Type:")) != NULL) {
								//content_length = atoi((const char *)ptr + 13);
								state = 2;
							}
							ihdr = 0;
						}
						break;
					case 2:
						hdr[ihdr++] = c = ctx->handle.Instance->DR;
						hdr[ihdr] = 0;
						if(c == '\n') {
							if(strlen((const char *)hdr) == 2) state = 3;
							ihdr = 0;
						}
						break;
					case 3:
						data_length++;
						c = ctx->handle.Instance->DR;
						HAL_FLASH_Program(FLASH_TYPEPROGRAM_BYTE, (uint32_t)base_addr++, c);
						if(content_length == data_length) goto close_connection;
						break;
				}
#endif
			}
		}
	}
	//close connection
	close_connection:
	//write binary firmware data info struct
	if(if_check_loadfile((uint8 *)0x08080000 + sizeof(bfd_info), sign, content_length)) {
		b_info.status = 0x01;					//start updating firmware during next restart
		b_info.len = content_length;
		memcpy(b_info.signature, sign, IF_KRONOS_SIGNATURE_LEN);
		ptr = (uint8 *)&b_info;
		base_addr = 0x08080000;
		for(b_len=0;b_len<sizeof(bfd_info);b_len++) HAL_FLASH_Program(FLASH_TYPEPROGRAM_BYTE, (uint32_t)base_addr++, ptr[b_len]);
	}
	HAL_FLASH_Lock();
	ctx->sock_close(conn);
	NET_UNLOCK_CRITICAL(ctx);
#if SHARD_RTOS_ENABLED
	os_exit_critical(cpu_sr);
#endif
	return content_length;		//unable to found +IPD prefix
}

uint8 if_check_loadfile(uint8 * offset, uint8 * signature, uint32 length) {
	Sha256 sha_ctx;
	uint8 b_len;
	uint8 sha_chksum[IF_KRONOS_SIGNATURE_LEN];
	
	wc_InitSha256(&sha_ctx);
	wc_Sha256Update(&sha_ctx, (const uint8 *)offset, length);
	wc_Sha256Final(&sha_ctx, sha_chksum);
	return (memcmp(sha_chksum, signature, IF_KRONOS_SIGNATURE_LEN) == 0);
}

void RTC_IRQHandler(void)
{
  	//if (RTC_GetITStatus(RTC_IT_SEC) != RESET)
  	{
    	/* Clear the RTC Second interrupt */
    	//RTC_ClearITPendingBit(RTC_IT_SEC);
		//LED1 =!LED1;  //LED1翻转
    	/* Wait until last write operation on RTC registers has finished */
    	//RTC_WaitForLastTask();
    	/* Reset RTC Counter when Time is 23:59:59 */
    	//if (RTC_GetCounter() == 0x00015180)
    	{
      	//RTC_SetCounter(0x0);
      	/* Wait until last write operation on RTC registers has finished */
      	//RTC_WaitForLastTask();
    	}
  	}
}

const uint8 kronboot[4347] = {
    0x28, 0x40, 0x00, 0x20, 0x9D, 0x61, 0x00, 0x08, 0x61, 0x6E, 0x00, 0x08, 0x57, 0x6E, 0x00, 0x08,
    0x5D, 0x6E, 0x00, 0x08, 0xE5, 0x61, 0x00, 0x08, 0xC9, 0x6F, 0x00, 0x08, 0x00, 0x00, 0x00, 0x00,
    0x00, 0x00, 0x00, 0x00, 0x00, 0x00, 0x00, 0x00, 0x00, 0x00, 0x00, 0x00, 0x9F, 0x6E, 0x00, 0x08,
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    0xDC, 0x6F, 0x00, 0x08, 0x00, 0x24, 0xF4, 0x00, 0x00, 0x00, 0x00 
} ;
